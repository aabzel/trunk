
&pinctrl {
	i2s0_default_alt: i2s0_default_alt {
		group1 {
			psels = <NRF_PSEL(I2S_SCK_M, 0, 6)>,
				<NRF_PSEL(I2S_LRCK_M, 0, 7)>,
				<NRF_PSEL(I2S_SDOUT, 0, 25)>,
				<NRF_PSEL(I2S_SDIN, 1, 4)>;
		};
	};
};

&i2s0 {
	status = "okay";
	pinctrl-0 = <&i2s0_default_alt>;
	pinctrl-names = "default";
};
