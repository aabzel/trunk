## source/boards/nrf5340_dk/device_tree/nrf5340dk_nrf5340_cpuapp_defconfig
```kconfig
# SPDX-License-Identifier: Apache-2.0

CONFIG_SOC_SERIES_NRF53X=y
CONFIG_SOC_NRF5340_CPUAPP_QKAA=y
CONFIG_BOARD_NRF5340DK_NRF5340_CPUAPP=y

CONFIG_BOARD_ENABLE_DCDC_APP=y
CONFIG_BOARD_ENABLE_DCDC_NET=y
CONFIG_BOARD_ENABLE_CPUNET=y

# Enable MPU
CONFIG_ARM_MPU=y

# Enable hardware stack protection
CONFIG_HW_STACK_PROTECTION=y

# Enable TrustZone-M
CONFIG_ARM_TRUSTZONE_M=y

# Enable PINCTRL
CONFIG_PINCTRL=y

# Enable GPIO
CONFIG_GPIO=y
CONFIG_NFCT_PINS_AS_GPIOS=y

# I2S
CONFIG_NRFX_I2S=y

# Enable NRFX_CLOCK for ACLK control
CONFIG_NRFX_CLOCK=y

# Enable uart driver
CONFIG_SERIAL=y

CONFIG_I2C=y

# NOTE: Since we are not using minimal libc, error codes from
#       minimal libc are not used
CONFIG_NEWLIB_LIBC=y

# enable console
CONFIG_CONSOLE=y
CONFIG_UART_CONSOLE=y

# Audio codec LC3 related defines
# FPU_SHARING enables preservation of the hardware floating point registers
# across context switches to allow multiple threads to perform concurrent
# floating point operations.
CONFIG_FPU=y
CONFIG_FPU_SHARING=y

# Bluetooth Low Energy
CONFIG_BT=y
```
